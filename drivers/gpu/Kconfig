## drivers/gpu/mali_kbase/Kconfig
```kconfig
menuconfig MALI_MIDGARD
    bool "Mali Midgard GPU support"
    default y
    help
      Enables the Mali Midgard GPU driver

if MALI_MIDGARD

config MALI_PLATFORM_NAME
    string "Mali platform"
    default "devicetree"

endif
```
